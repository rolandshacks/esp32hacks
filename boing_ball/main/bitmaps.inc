////////////////////////////////////////////////////////////////////////////////
// Bitmap data
// @generated
// clang-format off
////////////////////////////////////////////////////////////////////////////////

////////////////////////////////////////////////////////////////////////////////
// Bitmap 'ball0'
////////////////////////////////////////////////////////////////////////////////
static const uint8_t ball0_bitmap_pixels[] = {
  0x00, 0x00, 0x00, 0x03, 0x88, 0xf8, 0x00, 0x00, 
  0x00, 0x00, 0x73, 0xff, 0xce, 0xfe, 0x00, 0x00, 
  0x00, 0x01, 0x6f, 0xff, 0x8d, 0xff, 0x80, 0x80, 
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  0x00, 0x00, 0x00, 0x1f, 0x00, 0xc0, 0x00, 0x00
};

const graphics::Bitmap ball0_bitmap (
    32,                  // width
    32,                  // height
    true,                // true if alpha channel
    8,                   // bytes per line
    256,                 // bitmap size
    ball0_bitmap_pixels  // pixel data
);

////////////////////////////////////////////////////////////////////////////////
// Bitmap 'ball1'
////////////////////////////////////////////////////////////////////////////////
static const uint8_t ball1_bitmap_pixels[] = {
  0x00, 0x00, 0x02, 0x03, 0x88, 0xf8, 0x00, 0x00, 
  0x00, 0x00, 0x71, 0xff, 0xd6, 0xfe, 0x00, 0x00, 
  0x00, 0x01, 0x43, 0xff, 0xc6, 0xff, 0x80, 0x80, 
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  0x00, 0x00, 0x00, 0x1f, 0x00, 0xc0, 0x00, 0x00
};

const graphics::Bitmap ball1_bitmap (
    32,                  // width
    32,                  // height
    true,                // true if alpha channel
    8,                   // bytes per line
    256,                 // bitmap size
    ball1_bitmap_pixels  // pixel data
);

////////////////////////////////////////////////////////////////////////////////
// Bitmap 'ball2'
////////////////////////////////////////////////////////////////////////////////
static const uint8_t ball2_bitmap_pixels[] = {
  0x00, 0x00, 0x02, 0x03, 0x48, 0xf8, 0x00, 0x00, 
  0x00, 0x00, 0x78, 0xff, 0xe2, 0xfe, 0x00, 0x00, 
  0x00, 0x01, 0x21, 0xff, 0xe6, 0xff, 0x80, 0x80, 
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  0x00, 0x00, 0x00, 0x1f, 0x00, 0xc0, 0x00, 0x00
};

const graphics::Bitmap ball2_bitmap (
    32,                  // width
    32,                  // height
    true,                // true if alpha channel
    8,                   // bytes per line
    256,                 // bitmap size
    ball2_bitmap_pixels  // pixel data
);

////////////////////////////////////////////////////////////////////////////////
// Bitmap 'ball3'
////////////////////////////////////////////////////////////////////////////////
static const uint8_t ball3_bitmap_pixels[] = {
  0x00, 0x00, 0x03, 0x03, 0x70, 0xf8, 0x00, 0x00, 
  0x00, 0x00, 0x8c, 0xff, 0x30, 0xfe, 0x00, 0x00, 
  0x01, 0x01, 0x90, 0xff, 0x72, 0xff, 0x00, 0x80, 
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  0x00, 0x00, 0x1f, 0x1f, 0xc0, 0xc0, 0x00, 0x00
};

const graphics::Bitmap ball3_bitmap (
    32,                  // width
    32,                  // height
    true,                // true if alpha channel
    8,                   // bytes per line
    256,                 // bitmap size
    ball3_bitmap_pixels  // pixel data
);

////////////////////////////////////////////////////////////////////////////////
// Bitmap 'ball4'
////////////////////////////////////////////////////////////////////////////////
static const uint8_t ball4_bitmap_pixels[] = {
  0x00, 0x00, 0x01, 0x03, 0x70, 0xf8, 0x00, 0x00, 
  0x00, 0x00, 0x8e, 0xff, 0x28, 0xfe, 0x00, 0x00, 
  0x01, 0x01, 0xbc, 0xff, 0x39, 0xff, 0x00, 0x80, 
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  0x00, 0x00, 0x1f, 0x1f, 0xc0, 0xc0, 0x00, 0x00
};

const graphics::Bitmap ball4_bitmap (
    32,                  // width
    32,                  // height
    true,                // true if alpha channel
    8,                   // bytes per line
    256,                 // bitmap size
    ball4_bitmap_pixels  // pixel data
);

////////////////////////////////////////////////////////////////////////////////
// Bitmap 'ball5'
////////////////////////////////////////////////////////////////////////////////
static const uint8_t ball5_bitmap_pixels[] = {
  0x00, 0x00, 0x01, 0x03, 0xb0, 0xf8, 0x00, 0x00, 
  0x00, 0x00, 0x87, 0xff, 0x1c, 0xfe, 0x00, 0x00, 
  0x01, 0x01, 0xde, 0xff, 0x19, 0xff, 0x00, 0x80, 
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  0x00, 0x00, 0x1f, 0x1f, 0xc0, 0xc0, 0x00, 0x00
};

const graphics::Bitmap ball5_bitmap (
    32,                  // width
    32,                  // height
    true,                // true if alpha channel
    8,                   // bytes per line
    256,                 // bitmap size
    ball5_bitmap_pixels  // pixel data
);

