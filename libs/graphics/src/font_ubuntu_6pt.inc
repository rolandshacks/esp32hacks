/*
**  Font data for Ubuntu 12pt
*/

/* Character bitmaps for Ubuntu 12pt */
const uint8_t ubuntu_12pt_bitmaps[] = {
    /* @0 ' ' (2 pixels wide) */
    0x00,  //
    0x00,  //
    0x00,  //
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    0x00,  //

    /* @16 '!' (1 pixels wide) */
    0x00,  //
    0x00,  //
    0x80,  // #
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    0x00,  //

    /* @32 '"' (4 pixels wide) */
    0x90,  // #  #
    0x90,  // #  #
    0x90,  // #  #
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    0x00,  //

    /* @48 '#' (9 pixels wide) */
    0x00, 0x00,  //
    0x00, 0x00,  //
    0x11, 0x00,  //    #   #
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    0x00, 0x00,  //

    /* @80 '$' (7 pixels wide) */
    0x10,  //    #
    0x10,  //    #
    0x7C,  //  #####
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    0x00,  //

    /* @96 '%' (12 pixels wide) */
    0x00, 0x00,  //
    0x00, 0x00,  //
    0x70, 0x40,  //  ###     #
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    0x00, 0x00,  //

    /* @128 '&' (9 pixels wide) */
    0x00, 0x00,  //
    0x00, 0x00,  //
    0x3C, 0x00,  //   ####
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    0x00, 0x00,  //

    /* @160 ''' (1 pixels wide) */
    0x80,  // #
    0x80,  // #
    0x80,  // #
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    0x00,  //

    /* @176 '(' (4 pixels wide) */
    0x10,  //    #
    0x20,  //   #
    0x40,  //  #
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    0x10,  //    #

    /* @192 ')' (4 pixels wide) */
    0x80,  // #
    0x40,  //  #
    0x20,  //   #
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    0x80,  // #

    /* @208 '*' (7 pixels wide) */
    0x00,  //
    0x00,  //
    0x10,  //    #
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    0x00,  //

    /* @224 '+' (7 pixels wide) */
    0x00,  //
    0x00,  //
    0x00,  //
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    0x00,  //

    /* @240 ',' (2 pixels wide) */
    0x00,  //
    0x00,  //
    0x00,  //
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    0x80,  // #

    /* @256 '-' (4 pixels wide) */
    0x00,  //
    0x00,  //
    0x00,  //
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    0x00,  //

    /* @272 '.' (1 pixels wide) */
    0x00,  //
    0x00,  //
    0x00,  //
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    0x00,  //

    /* @288 '/' (7 pixels wide) */
    0x02,  //       #
    0x04,  //      #
    0x04,  //      #
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    0x80,  // #

    /* @304 '0' (7 pixels wide) */
    0x00,  //
    0x00,  //
    0x38,  //   ###
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    0x00,  //

    /* @320 '1' (4 pixels wide) */
    0x00,  //
    0x00,  //
    0x10,  //    #
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    0x00,  //

    /* @336 '2' (7 pixels wide) */
    0x00,  //
    0x00,  //
    0x38,  //   ###
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    0x00,  //

    /* @352 '3' (7 pixels wide) */
    0x00,  //
    0x00,  //
    0x78,  //  ####
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    0x00,  //

    /* @368 '4' (7 pixels wide) */
    0x00,  //
    0x00,  //
    0x04,  //      #
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    0x00,  //

    /* @384 '5' (7 pixels wide) */
    0x00,  //
    0x00,  //
    0x7E,  //  ######
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    0x00,  //

    /* @400 '6' (7 pixels wide) */
    0x00,  //
    0x00,  //
    0x1C,  //    ###
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    0x00,  //

    /* @416 '7' (7 pixels wide) */
    0x00,  //
    0x00,  //
    0xFE,  // #######
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    0x00,  //

    /* @432 '8' (7 pixels wide) */
    0x00,  //
    0x00,  //
    0x38,  //   ###
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    0x00,  //

    /* @448 '9' (7 pixels wide) */
    0x00,  //
    0x00,  //
    0x38,  //   ###
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    0x00,  //

    /* @464 ':' (1 pixels wide) */
    0x00,  //
    0x00,  //
    0x00,  //
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    0x00,  //

    /* @480 ';' (2 pixels wide) */
    0x00,  //
    0x00,  //
    0x00,  //
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    0x80,  // #

    /* @496 '<' (7 pixels wide) */
    0x00,  //
    0x00,  //
    0x00,  //
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    0x00,  //

    /* @512 '=' (7 pixels wide) */
    0x00,  //
    0x00,  //
    0x00,  //
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    0x00,  //

    /* @528 '>' (8 pixels wide) */
    0x00,  //
    0x00,  //
    0x00,  //
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    0x00,  //

    /* @544 '?' (5 pixels wide) */
    0x00,  //
    0x00,  //
    0x70,  //  ###
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    0x00,  //

    /* @560 '@' (13 pixels wide) */
    0x00, 0x00,  //
    0x00, 0x00,  //
    0x0F, 0x80,  //     #####
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    0x00, 0x00,  //

    /* @592 'A' (11 pixels wide) */
    0x00, 0x00,  //
    0x00, 0x00,  //
    0x04, 0x00,  //      #
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    0x00, 0x00,  //

    /* @624 'B' (8 pixels wide) */
    0x00,  //
    0x00,  //
    0xF8,  // #####
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    0x00,  //

    /* @640 'C' (9 pixels wide) */
    0x00, 0x00,  //
    0x00, 0x00,  //
    0x1F, 0x00,  //    #####
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    0x00, 0x00,  //

    /* @672 'D' (9 pixels wide) */
    0x00, 0x00,  //
    0x00, 0x00,  //
    0xFC, 0x00,  // ######
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    0x00, 0x00,  //

    /* @704 'E' (7 pixels wide) */
    0x00,  //
    0x00,  //
    0xFE,  // #######
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    0x00,  //

    /* @720 'F' (7 pixels wide) */
    0x00,  //
    0x00,  //
    0xFE,  // #######
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    0x00,  //

    /* @736 'G' (9 pixels wide) */
    0x00, 0x00,  //
    0x00, 0x00,  //
    0x1F, 0x00,  //    #####
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    0x00, 0x00,  //

    /* @768 'H' (9 pixels wide) */
    0x00, 0x00,  //
    0x00, 0x00,  //
    0x80, 0x80,  // #       #
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    0x00, 0x00,  //

    /* @800 'I' (1 pixels wide) */
    0x00,  //
    0x00,  //
    0x80,  // #
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    0x00,  //

    /* @816 'J' (7 pixels wide) */
    0x00,  //
    0x00,  //
    0x02,  //       #
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    0x00,  //

    /* @832 'K' (9 pixels wide) */
    0x00, 0x00,  //
    0x00, 0x00,  //
    0x81, 0x00,  // #      #
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    0x00, 0x00,  //

    /* @864 'L' (7 pixels wide) */
    0x00,  //
    0x00,  //
    0x80,  // #
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    0x00,  //

    /* @880 'M' (11 pixels wide) */
    0x00, 0x00,  //
    0x00, 0x00,  //
    0x40, 0x40,  //  #       #
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    0x00, 0x00,  //

    /* @912 'N' (9 pixels wide) */
    0x00, 0x00,  //
    0x00, 0x00,  //
    0x80, 0x80,  // #       #
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    0x00, 0x00,  //

    /* @944 'O' (10 pixels wide) */
    0x00, 0x00,  //
    0x00, 0x00,  //
    0x1E, 0x00,  //    ####
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    0x00, 0x00,  //

    /* @976 'P' (8 pixels wide) */
    0x00,  //
    0x00,  //
    0xFC,  // ######
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    0x00,  //

    /* @992 'Q' (10 pixels wide) */
    0x00, 0x00,  //
    0x00, 0x00,  //
    0x1E, 0x00,  //    ####
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    0x01, 0x80,  //        ##

    /* @1024 'R' (9 pixels wide) */
    0x00, 0x00,  //
    0x00, 0x00,  //
    0xFC, 0x00,  // ######
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    0x00, 0x00,  //

    /* @1056 'S' (7 pixels wide) */
    0x00,  //
    0x00,  //
    0x3C,  //   ####
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    0x00,  //

    /* @1072 'T' (9 pixels wide) */
    0x00, 0x00,  //
    0x00, 0x00,  //
    0xFF, 0x80,  // #########
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    0x00, 0x00,  //

    /* @1104 'U' (9 pixels wide) */
    0x00, 0x00,  //
    0x00, 0x00,  //
    0x80, 0x80,  // #       #
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    0x00, 0x00,  //

    /* @1136 'V' (9 pixels wide) */
    0x00, 0x00,  //
    0x00, 0x00,  //
    0x80, 0x80,  // #       #
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    0x00, 0x00,  //

    /* @1168 'W' (13 pixels wide) */
    0x00, 0x00,  //
    0x00, 0x00,  //
    0x80, 0x08,  // #           #
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    0x00, 0x00,  //

    /* @1200 'X' (9 pixels wide) */
    0x00, 0x00,  //
    0x00, 0x00,  //
    0x80, 0x80,  // #       #
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    0x00, 0x00,  //

    /* @1232 'Y' (9 pixels wide) */
    0x00, 0x00,  //
    0x00, 0x00,  //
    0x80, 0x80,  // #       #
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    0x00, 0x00,  //

    /* @1264 'Z' (7 pixels wide) */
    0x00,  //
    0x00,  //
    0xFE,  // #######
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    0x00,  //

    /* @1280 '[' (3 pixels wide) */
    0xE0,  // ###
    0x80,  // #
    0x80,  // #
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    0xE0,  // ###

    /* @1296 '\' (7 pixels wide) */
    0x80,  // #
    0x40,  //  #
    0x40,  //  #
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    0x02,  //       #

    /* @1312 ']' (3 pixels wide) */
    0xE0,  // ###
    0x20,  //   #
    0x20,  //   #
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    0xE0,  // ###

    /* @1328 '^' (7 pixels wide) */
    0x00,  //
    0x00,  //
    0x10,  //    #
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    0x00,  //

    /* @1344 '_' (8 pixels wide) */
    0x00,  //
    0x00,  //
    0x00,  //
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    0xFF,  // ########

    /* @1360 '`' (3 pixels wide) */
    0x00,  //
    0x80,  // #
    0x40,  //  #
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    0x00,  //

    /* @1376 'a' (6 pixels wide) */
    0x00,  //
    0x00,  //
    0x00,  //
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    0x00,  //

    /* @1392 'b' (7 pixels wide) */
    0x00,  //
    0x80,  // #
    0x80,  // #
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    0x00,  //

    /* @1408 'c' (6 pixels wide) */
    0x00,  //
    0x00,  //
    0x00,  //
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    0x00,  //

    /* @1424 'd' (7 pixels wide) */
    0x00,  //
    0x02,  //       #
    0x02,  //       #
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    0x00,  //

    /* @1440 'e' (7 pixels wide) */
    0x00,  //
    0x00,  //
    0x00,  //
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    0x00,  //

    /* @1456 'f' (5 pixels wide) */
    0x00,  //
    0x78,  //  ####
    0x80,  // #
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    0x00,  //

    /* @1472 'g' (7 pixels wide) */
    0x00,  //
    0x00,  //
    0x00,  //
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    0xF8,  // #####

    /* @1488 'h' (7 pixels wide) */
    0x00,  //
    0x80,  // #
    0x80,  // #
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    0x00,  //

    /* @1504 'i' (1 pixels wide) */
    0x00,  //
    0x80,  // #
    0x80,  // #
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    0x00,  //

    /* @1520 'j' (3 pixels wide) */
    0x00,  //
    0x20,  //   #
    0x20,  //   #
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    0xC0,  // ##

    /* @1536 'k' (6 pixels wide) */
    0x00,  //
    0x80,  // #
    0x80,  // #
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    0x00,  //

    /* @1552 'l' (3 pixels wide) */
    0x00,  //
    0x80,  // #
    0x80,  // #
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    0x00,  //

    /* @1568 'm' (11 pixels wide) */
    0x00, 0x00,  //
    0x00, 0x00,  //
    0x00, 0x00,  //
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    0x00, 0x00,  //

    /* @1600 'n' (7 pixels wide) */
    0x00,  //
    0x00,  //
    0x00,  //
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    0x00,  //

    /* @1616 'o' (8 pixels wide) */
    0x00,  //
    0x00,  //
    0x00,  //
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    0x00,  //

    /* @1632 'p' (7 pixels wide) */
    0x00,  //
    0x00,  //
    0x00,  //
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    0x80,  // #

    /* @1648 'q' (7 pixels wide) */
    0x00,  //
    0x00,  //
    0x00,  //
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    0x02,  //       #

    /* @1664 'r' (5 pixels wide) */
    0x00,  //
    0x00,  //
    0x00,  //
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    0x00,  //

    /* @1680 's' (5 pixels wide) */
    0x00,  //
    0x00,  //
    0x00,  //
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    0x00,  //

    /* @1696 't' (4 pixels wide) */
    0x00,  //
    0x00,  //
    0x80,  // #
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    0x00,  //

    /* @1712 'u' (7 pixels wide) */
    0x00,  //
    0x00,  //
    0x00,  //
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    0x00,  //

    /* @1728 'v' (7 pixels wide) */
    0x00,  //
    0x00,  //
    0x00,  //
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    0x00,  //

    /* @1744 'w' (13 pixels wide) */
    0x00, 0x00,  //
    0x00, 0x00,  //
    0x00, 0x00,  //
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    0x00, 0x00,  //

    /* @1776 'x' (8 pixels wide) */
    0x00,  //
    0x00,  //
    0x00,  //
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    0x00,  //

    /* @1792 'y' (7 pixels wide) */
    0x00,  //
    0x00,  //
    0x00,  //
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    0xC0,  // ##

    /* @1808 'z' (6 pixels wide) */
    0x00,  //
    0x00,  //
    0x00,  //
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    0x00,  //

    /* @1824 '{' (5 pixels wide) */
    0x18,  //    ##
    0x20,  //   #
    0x20,  //   #
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    0x18,  //    ##

    /* @1840 '|' (1 pixels wide) */
    0x80,  // #
    0x80,  // #
    0x80,  // #
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    0x80,  // #

    /* @1856 '}' (5 pixels wide) */
    0xC0,  // ##
    0x20,  //   #
    0x20,  //   #
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    0xC0,  // ##

    /* @1872 '~' (7 pixels wide) */
    0x00,  //
    0x00,  //
    0x00,  //
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    0x00,  //
};

/* Character descriptors for Ubuntu 12pt */
/* { [Char width in bits], [Offset into ubuntu_12ptCharBitmaps in bytes] } */
const font_char_desc_t ubuntu_12pt_char_desc[] = {
    {2, 0},     /*   */
    {1, 16},    /* ! */
    {4, 32},    /* " */
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    {7, 1872},  /* ~ */
};

/* Font information for Ubuntu 12pt */
const font_info_t ubuntu_12pt_font_info = {
    16,                    /*  Character height */
    1,                     /*  C */
    ' ',                   /*  Start character */
    '~',                   /*  End character */
    ubuntu_12pt_char_desc, /*  Character descriptor array */
    ubuntu_12pt_bitmaps,   /*  Character bitmap array */
};
