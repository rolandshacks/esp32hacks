/*
**  Font data for Game Played 12pt
*/

/* Character bitmaps for Game Played 12pt */
const uint8_t gamePlayed_12pt_bitmaps[] =
{
	/* @0 ' ' (2 pixels wide) */
	0x00, //
	0x00, //
	0x00, //
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	0x00, //

	/* @17 '!' (2 pixels wide) */
	0x00, //
	0x00, //
	0x00, //
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	0x00, //

	/* @34 '"' (5 pixels wide) */
	0x00, //
	0x00, //
	0x00, //
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	0x00, //

	/* @51 '#' (9 pixels wide) */
	0x00, 0x00, //
	0x00, 0x00, //
	0x00, 0x00, //
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	0x00, 0x00, //

	/* @85 '$' (9 pixels wide) */
	0x00, 0x00, //
	0x0C, 0x00, //     ##
	0x0C, 0x00, //     ##
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	0x00, 0x00, //

	/* @119 '%' (14 pixels wide) */
	0x00, 0x00, //
	0x00, 0x00, //
	0x00, 0x60, //          ##
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	0x00, 0x00, //

	/* @153 '&' (9 pixels wide) */
	0x00, 0x00, //
	0x00, 0x00, //
	0x00, 0x00, //
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	0x00, 0x00, //

	/* @187 ''' (2 pixels wide) */
	0x00, //
	0x00, //
	0x00, //
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	0x00, //

	/* @204 '(' (5 pixels wide) */
	0x38, //   ###
	0x78, //  ####
	0xE0, // ###
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	0x38, //   ###

	/* @221 ')' (5 pixels wide) */
	0xE0, // ###
	0xF0, // ####
	0x30, //   ##
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	0xE0, // ###

	/* @238 '*' (8 pixels wide) */
	0x00, //
	0x00, //
	0x00, //
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	0x00, //

	/* @255 '+' (8 pixels wide) */
	0x00, //
	0x00, //
	0x00, //
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	0x00, //

	/* @272 ',' (2 pixels wide) */
	0x00, //
	0x00, //
	0x00, //
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	0x00, //

	/* @289 '-' (8 pixels wide) */
	0x00, //
	0x00, //
	0x00, //
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	0x00, //

	/* @306 '.' (2 pixels wide) */
	0x00, //
	0x00, //
	0x00, //
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	0x00, //

	/* @323 '/' (8 pixels wide) */
	0x00, //
	0x07, //      ###
	0x06, //      ##
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	0x00, //

	/* @340 '0' (9 pixels wide) */
	0x00, 0x00, //
	0x00, 0x00, //
	0x00, 0x00, //
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	0x00, 0x00, //

	/* @374 '1' (4 pixels wide) */
	0x00, //
	0x00, //
	0x00, //
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	0x00, //

	/* @391 '2' (9 pixels wide) */
	0x00, 0x00, //
	0x00, 0x00, //
	0x00, 0x00, //
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	0x00, 0x00, //

	/* @425 '3' (9 pixels wide) */
	0x00, 0x00, //
	0x00, 0x00, //
	0x00, 0x00, //
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	0x00, 0x00, //

	/* @459 '4' (9 pixels wide) */
	0x00, 0x00, //
	0x00, 0x00, //
	0x00, 0x00, //
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	0x00, 0x00, //

	/* @493 '5' (9 pixels wide) */
	0x00, 0x00, //
	0x00, 0x00, //
	0x00, 0x00, //
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	0x00, 0x00, //

	/* @527 '6' (9 pixels wide) */
	0x00, 0x00, //
	0x00, 0x00, //
	0x00, 0x00, //
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	0x00, 0x00, //

	/* @561 '7' (9 pixels wide) */
	0x00, 0x00, //
	0x00, 0x00, //
	0x00, 0x00, //
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	0x00, 0x00, //

	/* @595 '8' (9 pixels wide) */
	0x00, 0x00, //
	0x00, 0x00, //
	0x00, 0x00, //
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	0x00, 0x00, //

	/* @629 '9' (9 pixels wide) */
	0x00, 0x00, //
	0x00, 0x00, //
	0x00, 0x00, //
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	0x00, 0x00, //

	/* @663 ':' (2 pixels wide) */
	0x00, //
	0x00, //
	0x00, //
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	0x00, //

	/* @680 ';' (2 pixels wide) */
	0x00, //
	0x00, //
	0x00, //
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	0x00, //

	/* @697 '<' (9 pixels wide) */
	0x00, 0x00, //
	0x00, 0x00, //
	0x00, 0x00, //
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	0x00, 0x00, //

	/* @731 '=' (8 pixels wide) */
	0x00, //
	0x00, //
	0x00, //
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	0x00, //

	/* @748 '>' (9 pixels wide) */
	0x00, 0x00, //
	0x00, 0x00, //
	0x00, 0x00, //
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	0x00, 0x00, //

	/* @782 '?' (9 pixels wide) */
	0x00, 0x00, //
	0x00, 0x00, //
	0x00, 0x00, //
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	0x00, 0x00, //

	/* @816 '@' (13 pixels wide) */
	0x00, 0x00, //
	0x00, 0x00, //
	0x3F, 0xE0, //   #########
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	0x00, 0x00, //

	/* @850 'A' (9 pixels wide) */
	0x00, 0x00, //
	0x00, 0x00, //
	0x00, 0x00, //
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	0x00, 0x00, //

	/* @884 'B' (10 pixels wide) */
	0x00, 0x00, //
	0x00, 0x00, //
	0x00, 0x00, //
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	0x00, 0x00, //

	/* @918 'C' (9 pixels wide) */
	0x00, 0x00, //
	0x00, 0x00, //
	0x00, 0x00, //
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	0x00, 0x00, //

	/* @952 'D' (10 pixels wide) */
	0x00, 0x00, //
	0x00, 0x00, //
	0x00, 0x00, //
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	0x00, 0x00, //

	/* @986 'E' (9 pixels wide) */
	0x00, 0x00, //
	0x00, 0x00, //
	0x00, 0x00, //
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	0x00, 0x00, //

	/* @1020 'F' (9 pixels wide) */
	0x00, 0x00, //
	0x00, 0x00, //
	0x00, 0x00, //
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	0x00, 0x00, //

	/* @1054 'G' (9 pixels wide) */
	0x00, 0x00, //
	0x00, 0x00, //
	0x00, 0x00, //
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	0x00, 0x00, //

	/* @1088 'H' (9 pixels wide) */
	0x00, 0x00, //
	0x00, 0x00, //
	0x00, 0x00, //
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	0x00, 0x00, //

	/* @1122 'I' (3 pixels wide) */
	0x00, //
	0x00, //
	0x00, //
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	0x00, //

	/* @1139 'J' (9 pixels wide) */
	0x00, 0x00, //
	0x00, 0x00, //
	0x00, 0x00, //
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	0x00, 0x00, //

	/* @1173 'K' (9 pixels wide) */
	0x00, 0x00, //
	0x00, 0x00, //
	0x00, 0x00, //
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	0x00, 0x00, //

	/* @1207 'L' (9 pixels wide) */
	0x00, 0x00, //
	0x00, 0x00, //
	0x00, 0x00, //
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	0x00, 0x00, //

	/* @1241 'M' (13 pixels wide) */
	0x00, 0x00, //
	0x00, 0x00, //
	0x00, 0x00, //
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	0x00, 0x00, //

	/* @1275 'N' (9 pixels wide) */
	0x00, 0x00, //
	0x00, 0x00, //
	0x00, 0x00, //
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	0x00, 0x00, //

	/* @1309 'O' (9 pixels wide) */
	0x00, 0x00, //
	0x00, 0x00, //
	0x00, 0x00, //
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	0x00, 0x00, //

	/* @1343 'P' (9 pixels wide) */
	0x00, 0x00, //
	0x00, 0x00, //
	0x00, 0x00, //
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	0x00, 0x00, //

	/* @1377 'Q' (9 pixels wide) */
	0x00, 0x00, //
	0x00, 0x00, //
	0x00, 0x00, //
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	0x00, 0x00, //

	/* @1411 'R' (9 pixels wide) */
	0x00, 0x00, //
	0x00, 0x00, //
	0x00, 0x00, //
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	0x00, 0x00, //

	/* @1445 'S' (9 pixels wide) */
	0x00, 0x00, //
	0x00, 0x00, //
	0x00, 0x00, //
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	0x00, 0x00, //

	/* @1479 'T' (9 pixels wide) */
	0x00, 0x00, //
	0x00, 0x00, //
	0x00, 0x00, //
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	0x00, 0x00, //

	/* @1513 'U' (9 pixels wide) */
	0x00, 0x00, //
	0x00, 0x00, //
	0x00, 0x00, //
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	0x00, 0x00, //

	/* @1547 'V' (9 pixels wide) */
	0x00, 0x00, //
	0x00, 0x00, //
	0x00, 0x00, //
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	0x00, 0x00, //

	/* @1581 'W' (13 pixels wide) */
	0x00, 0x00, //
	0x00, 0x00, //
	0x00, 0x00, //
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	0x00, 0x00, //

	/* @1615 'X' (9 pixels wide) */
	0x00, 0x00, //
	0x00, 0x00, //
	0x00, 0x00, //
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	0x00, 0x00, //

	/* @1649 'Y' (9 pixels wide) */
	0x00, 0x00, //
	0x00, 0x00, //
	0x00, 0x00, //
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	0x00, 0x00, //

	/* @1683 'Z' (9 pixels wide) */
	0x00, 0x00, //
	0x00, 0x00, //
	0x00, 0x00, //
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	0x00, 0x00, //

	/* @1717 '[' (4 pixels wide) */
	0x70, //  ###
	0xF0, // ####
	0xC0, // ##
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	0x70, //  ###

	/* @1734 '\' (8 pixels wide) */
	0x00, //
	0xC0, // ##
	0xE0, // ###
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	0x00, //

	/* @1751 ']' (4 pixels wide) */
	0xE0, // ###
	0xF0, // ####
	0x30, //   ##
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	0xE0, // ###

	/* @1768 '^' (8 pixels wide) */
	0x00, //
	0x00, //
	0x00, //
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	0x00, //

	/* @1785 '_' (9 pixels wide) */
	0x00, 0x00, //
	0x00, 0x00, //
	0x00, 0x00, //
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	0x00, 0x00, //

	/* @1819 '`' (4 pixels wide) */
	0xE0, // ###
	0x70, //  ###
	0x00, //
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	0x00, //

	/* @1836 'a' (9 pixels wide) */
	0x00, 0x00, //
	0x00, 0x00, //
	0x00, 0x00, //
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	0x00, 0x00, //

	/* @1870 'b' (10 pixels wide) */
	0x00, 0x00, //
	0x00, 0x00, //
	0x00, 0x00, //
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	0x00, 0x00, //

	/* @1904 'c' (9 pixels wide) */
	0x00, 0x00, //
	0x00, 0x00, //
	0x00, 0x00, //
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	0x00, 0x00, //

	/* @1938 'd' (10 pixels wide) */
	0x00, 0x00, //
	0x00, 0x00, //
	0x00, 0x00, //
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	0x00, 0x00, //

	/* @1972 'e' (9 pixels wide) */
	0x00, 0x00, //
	0x00, 0x00, //
	0x00, 0x00, //
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	0x00, 0x00, //

	/* @2006 'f' (9 pixels wide) */
	0x00, 0x00, //
	0x00, 0x00, //
	0x00, 0x00, //
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	0x00, 0x00, //

	/* @2040 'g' (9 pixels wide) */
	0x00, 0x00, //
	0x00, 0x00, //
	0x00, 0x00, //
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	0x00, 0x00, //

	/* @2074 'h' (9 pixels wide) */
	0x00, 0x00, //
	0x00, 0x00, //
	0x00, 0x00, //
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	0x00, 0x00, //

	/* @2108 'i' (3 pixels wide) */
	0x00, //
	0x00, //
	0x00, //
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	0x00, //

	/* @2125 'j' (9 pixels wide) */
	0x00, 0x00, //
	0x00, 0x00, //
	0x00, 0x00, //
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	0x00, 0x00, //

	/* @2159 'k' (9 pixels wide) */
	0x00, 0x00, //
	0x00, 0x00, //
	0x00, 0x00, //
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	0x00, 0x00, //

	/* @2193 'l' (9 pixels wide) */
	0x00, 0x00, //
	0x00, 0x00, //
	0x00, 0x00, //
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	0x00, 0x00, //

	/* @2227 'm' (13 pixels wide) */
	0x00, 0x00, //
	0x00, 0x00, //
	0x00, 0x00, //
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	0x00, 0x00, //

	/* @2261 'n' (9 pixels wide) */
	0x00, 0x00, //
	0x00, 0x00, //
	0x00, 0x00, //
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	0x00, 0x00, //

	/* @2295 'o' (9 pixels wide) */
	0x00, 0x00, //
	0x00, 0x00, //
	0x00, 0x00, //
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	0x00, 0x00, //

	/* @2329 'p' (9 pixels wide) */
	0x00, 0x00, //
	0x00, 0x00, //
	0x00, 0x00, //
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	0x00, 0x00, //

	/* @2363 'q' (9 pixels wide) */
	0x00, 0x00, //
	0x00, 0x00, //
	0x00, 0x00, //
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	0x00, 0x00, //

	/* @2397 'r' (9 pixels wide) */
	0x00, 0x00, //
	0x00, 0x00, //
	0x00, 0x00, //
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	0x00, 0x00, //

	/* @2431 's' (9 pixels wide) */
	0x00, 0x00, //
	0x00, 0x00, //
	0x00, 0x00, //
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	0x00, 0x00, //

	/* @2465 't' (9 pixels wide) */
	0x00, 0x00, //
	0x00, 0x00, //
	0x00, 0x00, //
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	0x00, 0x00, //

	/* @2499 'u' (9 pixels wide) */
	0x00, 0x00, //
	0x00, 0x00, //
	0x00, 0x00, //
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	0x00, 0x00, //

	/* @2533 'v' (9 pixels wide) */
	0x00, 0x00, //
	0x00, 0x00, //
	0x00, 0x00, //
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	0x00, 0x00, //

	/* @2567 'w' (13 pixels wide) */
	0x00, 0x00, //
	0x00, 0x00, //
	0x00, 0x00, //
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	0x00, 0x00, //

	/* @2601 'x' (9 pixels wide) */
	0x00, 0x00, //
	0x00, 0x00, //
	0x00, 0x00, //
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	0x00, 0x00, //

	/* @2635 'y' (9 pixels wide) */
	0x00, 0x00, //
	0x00, 0x00, //
	0x00, 0x00, //
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	0x00, 0x00, //

	/* @2669 'z' (9 pixels wide) */
	0x00, 0x00, //
	0x00, 0x00, //
	0x00, 0x00, //
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	0x00, 0x00, //

	/* @2703 '{' (6 pixels wide) */
	0x3C, //   ####
	0x3C, //   ####
	0x30, //   ##
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	0x1C, //    ###

	/* @2720 '|' (2 pixels wide) */
	0xC0, // ##
	0xC0, // ##
	0xC0, // ##
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	0xC0, // ##

	/* @2737 '}' (6 pixels wide) */
	0xE0, // ###
	0xF0, // ####
	0x30, //   ##
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	0xE0, // ###

	/* @2754 '~' (10 pixels wide) */
	0x00, 0x00, //
	0x00, 0x00, //
	0x00, 0x00, //
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	0x00, 0x00, //
};

/* Character descriptors for Game Played 12pt */
/* { [Char width in bits], [Offset into gamePlayed_12ptCharBitmaps in bytes] } */
const font_char_desc_t gamePlayed_12pt_char_desc[] =
{
	{2, 0}, 		/*   */
	{2, 17}, 		/* ! */
	{5, 34}, 		/* " */
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	{10, 2754}, 		/* ~ */
};

/* Font information for Game Played 12pt */
const font_t game_12pt_font_info =
{
	17, /*  Character height */
    1,                  /*  C */
	' ', /*  Start character */
	'~', /*  End character */
	gamePlayed_12pt_char_desc, /*  Character descriptor array */
	gamePlayed_12pt_bitmaps, /*  Character bitmap array */
};
