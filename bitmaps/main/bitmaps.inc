////////////////////////////////////////////////////////////////////////////////
// Bitmap data
// @generated
// clang-format off
////////////////////////////////////////////////////////////////////////////////

////////////////////////////////////////////////////////////////////////////////
// Bitmap 'background'
////////////////////////////////////////////////////////////////////////////////
static const uint8_t background_bitmap_pixels[] = {
  0xf0, 0xff, 0x7c, 0xff, 0x7e, 0xff, 0x70, 0xff, 0x7c, 0xff, 0xc3, 0xff, 0x87, 0xff, 0x0f, 0xff, 0x1e, 0xff, 0x3c, 0xff, 0xc1, 0xff, 0xf1, 0xff, 0x81, 0xff, 0xc1, 0xff, 0xf8, 0xff, 0x08, 0xff,
  0x40, 0xff, 0x18, 0xff, 0x3f, 0xff, 0xf8, 0xff, 0x3b, 0xff, 0xc3, 0xff, 0xc7, 0xff, 0x8e, 0xff, 0x1c, 0xff, 0x3c, 0xff, 0x23, 0xff, 0xe0, 0xff, 0x03, 0xff, 0xe7, 0xff, 0xfd, 0xff, 0xfc, 0xff,
  0x70, 0xff, 0x18, 0xff, 0x0c, 0xff, 0x7c, 0xff, 0x21, 0xff, 0xe3, 0xff, 0xc7, 0xff, 0x8e, 0xff, 0x1c, 0xff, 0x38, 0xff, 0x7b, 0xff, 0xc1, 0xff, 0xcf, 0xff, 0xef, 0xff, 0xf1, 0xff, 0xfe, 0xff,
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  0x03, 0xff, 0xfc, 0xff, 0x7f, 0xff, 0xc0, 0xff, 0x1f, 0xff, 0xff, 0xff, 0xf0, 0xff, 0x0f, 0xff, 0xf0, 0xff, 0x10, 0xff, 0x07, 0xff, 0xfc, 0xff, 0x01, 0xff, 0xc0, 0xff, 0x3f, 0xff, 0xfc, 0xff
};

const graphics::Bitmap background_bitmap (
    128,                      // width
    64,                       // height
    true,                     // true if alpha channel
    32,                       // bytes per line
    2048,                     // bitmap size
    background_bitmap_pixels  // pixel data
);

////////////////////////////////////////////////////////////////////////////////
// Bitmap 'hello'
////////////////////////////////////////////////////////////////////////////////
static const uint8_t hello_bitmap_pixels[] = {
  0xdd, 0xff, 0x00, 0x00, 0xdd, 0xff, 0x0d, 0x0f, 0xdd, 0xff, 0xdd, 0xff, 0xd0, 0xf0, 0xdd, 0xff, 0x00, 0x00, 0x00, 0x00, 0x0d, 0x0f, 0xd0, 0xf0, 0x00, 0x00, 0x00, 0x00, 0x03, 0x03, 0x77, 0xff, 0x40, 0xc0,
  0xb6, 0xff, 0x00, 0x00, 0xb6, 0xff, 0x0b, 0x0f, 0x6b, 0xff, 0x6b, 0xff, 0x60, 0xf0, 0xb6, 0xff, 0x00, 0x00, 0x00, 0x00, 0x0b, 0x0f, 0x60, 0xf0, 0x00, 0x00, 0x00, 0x00, 0x0a, 0x0f, 0xda, 0xff, 0xe0, 0xf0,
  0xfc, 0xff, 0x00, 0x00, 0xfc, 0xff, 0x0f, 0x0f, 0xff, 0xff, 0xff, 0xff, 0xc0, 0xf0, 0xfc, 0xff, 0x00, 0x00, 0x00, 0x00, 0x0f, 0x0f, 0xc0, 0xf0, 0x00, 0x00, 0x00, 0x00, 0x2f, 0x3f, 0xff, 0xff, 0xdc, 0xfc,
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  0x80, 0xff, 0x00, 0x00, 0x80, 0xff, 0x08, 0x0f, 0x00, 0xff, 0x00, 0xff, 0x00, 0xf0, 0x80, 0xff, 0x00, 0xff, 0x00, 0xff, 0x08, 0x0f, 0x00, 0xff, 0x00, 0xff, 0x00, 0xf0, 0x00, 0x03, 0x00, 0xff, 0x00, 0xc0
};

const graphics::Bitmap hello_bitmap (
    136,                 // width
    40,                  // height
    true,                // true if alpha channel
    34,                  // bytes per line
    1360,                // bitmap size
    hello_bitmap_pixels  // pixel data
);
