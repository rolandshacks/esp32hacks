////////////////////////////////////////////////////////////////////////////////
// Bitmap data
// @generated
// clang-format off
////////////////////////////////////////////////////////////////////////////////

////////////////////////////////////////////////////////////////////////////////
// Bitmap 'hello'
////////////////////////////////////////////////////////////////////////////////
static const uint8_t hello_bitmap_pixels[] = {
  0xf0, 0xf0, 0x3c, 0x3c, 0x3f, 0x3f, 0xfb, 0xfb, 0xc0, 0xc0, 0x07, 0x07, 0x80, 0x80, 0x01, 0x01, 0xfe, 0xfe, 0x00, 0x00, 
  0xf0, 0xf0, 0x3c, 0x3c, 0xff, 0xff, 0xfb, 0xfb, 0xc0, 0xc0, 0x07, 0x07, 0x80, 0x80, 0x07, 0x07, 0xff, 0xff, 0x80, 0x80, 
  0xf0, 0xf0, 0x3c, 0x3c, 0xf0, 0xf0, 0x03, 0x03, 0xc0, 0xc0, 0x07, 0x07, 0x80, 0x80, 0x07, 0x07, 0x87, 0x87, 0x80, 0x80, 
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  0xfc, 0xfc, 0x3c, 0x3c, 0x3f, 0x3f, 0xf8, 0xf8, 0x7f, 0x7f, 0xf0, 0xf0, 0xff, 0xff, 0xe1, 0xe1, 0xfe, 0xfe, 0x00, 0x00
};

const graphics::Bitmap hello_bitmap (
    74,                  // width
    14,                  // height
    true,                // true if alpha channel
    20,                  // bytes per line
    280,                 // bitmap size
    hello_bitmap_pixels  // pixel data
);

////////////////////////////////////////////////////////////////////////////////
// Bitmap 'world'
////////////////////////////////////////////////////////////////////////////////
static const uint8_t world_bitmap_pixels[] = {
  0xf0, 0xf0, 0x3c, 0x3c, 0x3f, 0x3f, 0xc3, 0xc3, 0xff, 0xff, 0x87, 0x87, 0x80, 0x80, 0x0f, 0x0f, 0xfe, 0xfe, 0x03, 0x03, 0xe0, 0xe0, 
  0xf0, 0xf0, 0x3c, 0x3c, 0xff, 0xff, 0xf3, 0xf3, 0xff, 0xff, 0xe7, 0xe7, 0x80, 0x80, 0x0f, 0x0f, 0xff, 0xff, 0x83, 0x83, 0xe0, 0xe0, 
  0xf0, 0xf0, 0x3c, 0x3c, 0xf0, 0xf0, 0xf3, 0xf3, 0xc1, 0xc1, 0xe7, 0xe7, 0x80, 0x80, 0x0f, 0x0f, 0x07, 0x07, 0x83, 0x83, 0xe0, 0xe0, 
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  0xf8, 0xf8, 0x7c, 0x7c, 0x3f, 0x3f, 0xc3, 0xc3, 0xf0, 0xf0, 0xf0, 0xf0, 0xff, 0xff, 0xef, 0xef, 0xfe, 0xfe, 0x01, 0x01, 0xc0, 0xc0
};

const graphics::Bitmap world_bitmap (
    83,                  // width
    14,                  // height
    true,                // true if alpha channel
    22,                  // bytes per line
    308,                 // bitmap size
    world_bitmap_pixels  // pixel data
);

